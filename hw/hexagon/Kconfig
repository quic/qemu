## hw/hexagon/Kconfig
```kconfig
config HEX_VIRT
    depends on DRAGON
    select VIRTIO_MMIO

config DRAGON
    bool
    imply PTIMER
    depends on TCG
    select L2VIC  # Vector PIC
    depends on TCG
    select PL011

config HEX_VIRT
    depends on DRAGON
    select VIRTIO_MMIO
    select VIRTIO_RNG
    select PL031
    select PL011
```
